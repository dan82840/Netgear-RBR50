## git_home/qsdk-hyfi.git/feeds/hyfi/qca-hyfi-bridging/qca-libhyfi-bridge/Config.in
```kconfig
menu "Configuration"

config QCA_HYFI_USE_DNI_GIT
	bool "Fetch source from DNI git repository"
	default y

config WIFISON_HIFY_GIT_TREEISH
        string
        prompt "treeish of wifison hify git repository"
        default "55d7c7d943c4f2345b542668eff38e04dac059e8"
        help
           Input the treeish of wifison hify git repository which you want to build
endmenu
```

## package/ieee1905_security/qca-ieee1905-init/Config.in
```kconfig
menu "Configuration"

config QCA_IEEE1905SECU_USE_DNI_GIT
	bool "Fetch source from DNI git repository"
	default y

config WIFISON_IEEE1905_GIT_TREEISH
        string
        prompt "treeish of wifison IEEE 1905 git repository"
        default "524e0c3b9ab3f87c6d35e9f8f15556e28ff066ba"
        help
           Input the treeish of wifison IEEE1905 git repository which you want to build

endmenu
```

## package/whc/qca-whc-init/Config.in
```kconfig
menu "Configuration"

config QCA_WHC_USE_DNI_GIT
	bool "Fetch source from DNI git repository"
	default y

config WIFISON_WHC_GIT_TREEISH
        string
        prompt "treeish of wifison whc git repository"
        default "e705da9ed27e4e3a8bf3234e066ff207ad43264e"
        help
           Input the treeish of wifison whc git repository which you want to build





endmenu
```
